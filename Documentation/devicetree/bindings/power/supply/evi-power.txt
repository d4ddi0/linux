## Documentation/devicetree/bindings/power/supply/evi-power.txt
```
Binding for UniWest evi power supply

Required properties:
- compatible: Should contain one of the following:
 * "uniwest,evi-pb"
- reg:			   integer, i2c address of the device.
- spi-max-frequency:	   Max spi clock frequency in Hz
- reg:			   The spi chipselect
- interrupts:		   Interrupts for power supply events
- interrupt-parent:	   The interrupt controller

Example

pwr_mcu: lpc1227@0 {
	pwr_mcu: lpc1227@0 {
	compatible = "uniwest,evi-pb";
	spi-max-frequency = <2450000>;
	reg = <0>;
	interrupts = <10 IRQ_TYPE_EDGE_RISING>;
	interrupt-parent = <&gpio2>;
};
```

## drivers/misc/uniwest-eddy/Kconfig
```kconfig
#
# Uniwest EVI devices
#

config UNIWEST_EDDY
	tristate "Uniwest EVI eddy current sensor"
	default n
	help
	  This option enables support for Uniwest EVI eddy current sensor

	  To compile this driver as a module, choose M here: the module will
	  be called uniwest-eddy
	  If you are not sure, say N here.
```
